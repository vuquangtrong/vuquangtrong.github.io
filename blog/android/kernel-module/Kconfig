## blog/android/kernel-module/invcase/Kconfig
```kconfig
# Invcase Device configuration

menuconfig INVCASE
	tristate "Inverse Characters Case"
	default y
	help
	  Say Y to include this module
	  Say N will not build this module
	  Say M to build this module but not include to kernel yet
```
